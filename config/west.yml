## config/west.yml
```yaml
manifest:
  remotes:
     # zmk official
    - name: zmkfirmware
      url-base: https://github.com/zmkfirmware
      # petejohanson
    - name: petejohanson
      url-base: https://github.com/petejohanson
  projects:
    - name: zmk
      remote: zmkfirmware
      revision: main
      import: app/west.yml
  self:
    path: config
```
